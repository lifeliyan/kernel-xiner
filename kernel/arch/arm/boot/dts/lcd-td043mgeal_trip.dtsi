/*
 * RockChip. LCD_TD043MGEA1 FOR FPGA
 *
 */

/ {

		disp_timings: display-timings {
                        native-mode = <&timing0>;
                        timing0: timing0 {
				screen-type = <SCREEN_RGB>;
				out-face    = <OUT_P888>;
				clock-frequency = <37690000>;
				//clock-frequency =   <38000000>;
				hactive = <854>;
				vactive = <480>;
				hback-porch = <124>;     //206 
				hfront-porch = <53>;     //40
				vback-porch = <50>;      //25
				vfront-porch = <30>;     //10
				hsync-len = <80>;        //10
				vsync-len = <13>;        //10
				hsync-active = <0>;
				vsync-active = <0>;
				de-active = <1>;
				pixelclk-active = <0>;
				swap-rb = <0>;
				swap-rg = <0>;
				swap-gb = <0>;
                     	};
               };
};
